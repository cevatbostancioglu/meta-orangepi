## yocto/meta-orangepi/conf/distro/orangepi.conf
```bitbake
DISTRO = "orangepi"

PACKAGE_CLASSES = "package_ipk"

DISTRO_NAME = "orangepi"

DISTRO_FEATURES_append = " ext2 alsa systemd"

DISTRO_FEATURES_append_orange-pi-zero = " wifi"
DISTRO_FEATURES_append_orange-pi-pc = " x11 opengl"
DISTRO_FEATURES_append_orange-pi-pc-plus = " wifi"

VIRTUAL-RUNTIME_init_manager = "systemd"
DISTRO_FEATURES_BACKFILL_CONSIDERED = "sysvinit"
VIRTUAL-RUNTIME_initscripts = ""
```

## yocto/meta-orangepi/conf/layer.conf
```bitbake
# We have a conf and classes directory, add to BBPATH
BBPATH .= ":${LAYERDIR}"

# We have recipes-* directories, add to BBFILES
BBFILES += "${LAYERDIR}/recipes-*/*/*.bb \
	${LAYERDIR}/recipes-*/*/*.bbappend"

BBFILE_COLLECTIONS += "meta-orangepi"
BBFILE_PATTERN_meta-orangepi = "^${LAYERDIR}/"
BBFILE_PRIORITY_meta-orangepi = "11"
```

## yocto/meta-orangepi/conf/machine/orange-pi-pc2.conf
```bitbake
#@TYPE: Machine
#@NAME: orange-pi-pc-plus
#@DESCRIPTION: Machine configuration for the orange-pi-pc-plus, base on allwinner H3 CPU

require conf/machine/include/sun50i.inc

PREFERRED_VERSION_u-boot = "v2019.01%"
PREFERRED_PROVIDER_virtual/kernel = "linux-orangepi-zero"

KERNEL_DEVICETREE = "allwinner/sun50i-h5-orangepi-pc2.dtb"
UBOOT_MACHINE = "orangepi_pc2_defconfig"
```
